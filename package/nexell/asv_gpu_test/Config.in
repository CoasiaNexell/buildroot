## package/nexell/asv_gpu_test/Config.in
```kconfig
config BR2_PACKAGE_ASV_GPU_TEST
	bool "asv_gpu_test"
	select BR2_PACKAGE_LIBNX_RENDERER
	select BR2_PACKAGE_LIBNX_DRM_ALLOCATOR
	select BR2_PACKAGE_LIBNX_MALI
	select BR2_PACKAGE_LIBDRM_NEXELL
#	select BR2_PACKAGE_WAYLAND
#	select BR2_PACKAGE_WAYLAND_PROTOCOLS
	help
	  Support asv_gpu_test
```

## package/nexell/library/Config.in
```kconfig
menu "Librararies"
source "package/nexell/library/libnx_video_alloc/Config.in"
source "package/nexell/library/libnx_video_api/Config.in"
source "package/nexell/library/libnx_renderer/Config.in"
source "package/nexell/library/libnx_drm_allocator/Config.in"
source "package/nexell/library/libnx_mali/Config.in"
source "package/nexell/library/libdrm_nexell/Config.in"
endmenu
```

## package/nexell/library/libdrm_nexell/Config.in
```kconfig
config BR2_PACKAGE_LIBDRM_NEXELL
	bool "libdrm_nexell"
	select BR2_PACKAGE_LIBPCIACCESS
	help
	  Support drm_nexell
```

## package/nexell/library/libnx_drm_allocator/Config.in
```kconfig
config BR2_PACKAGE_LIBNX_DRM_ALLOCATOR
	bool "nx_drm_allocator"
	help
	  Support renderer
```

## package/nexell/library/libnx_renderer/Config.in
```kconfig
config BR2_PACKAGE_LIBNX_RENDERER
	bool "libnx_renderer"
	help
	  Support renderer
```
